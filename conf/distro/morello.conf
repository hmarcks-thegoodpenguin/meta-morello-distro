## conf/distro/morello.conf
```bitbake
DISTRO = "morello"

DISTRO_NAME = "Morello Dev Kit Distro"

DISTRO_VERSION_BASE = "1.0"
DISTRO_VERSION = "${DISTRO_VERSION_BASE}+snapshot-${DATE}"
DISTRO_CODENAME = "kirkstone-${DISTRO}-r${DISTRO_VERSION_BASE}"

MAINTAINER = "P Zalewski <pzalewski@thegoodpenguin.co.uk; H Carter <hcarter@thegoodpenguin.co.uk>"

CONF_VERSION = "2"

DISTRO = "morello"

INIT_MANAGER = "systemd"

PREFERRED_VERSION_postgresql-morello = "9.6"
PREFERRED_VERSION_php = "7.4.33"
```

## conf/layer.conf
```bitbake
BBPATH := "${BBPATH}:${LAYERDIR}"

BBFILES := "${BBFILES} \
            ${LAYERDIR}/recipes-*/*/*.bb \
            ${LAYERDIR}/recipes-*/*/*.bbappend"

BBFILE_COLLECTIONS           += "meta-morello-distro"
BBFILE_PATTERN_meta-morello-distro := "^${LAYERDIR}/"
BBFILE_PRIORITY_meta-morello-distro = "5"

LAYERDEPENDS_meta-morello-distro= " \
    meta-morello \
    openembedded-layer \
    meta-python \
    networking-layer \
    webserver \
    filesystems-layer \
"
LAYERSERIES_COMPAT_meta-morello-distro = "kirkstone"

MORELLO_LAYER_SRC_REF[poky]                = "407c3e0237d947ec003bdd1af89a226121c7939c"
MORELLO_LAYER_SRC_REF[meta-openembedded]   = "278ec081a64e6a7679d6def550101158126cd935"
MORELLO_LAYER_SRC_REF[meta-cloud-services] = "65f6633fe3159fe1fe6cb3701249c76aeccd116a"
```
